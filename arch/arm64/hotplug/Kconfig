## arch/arm64/hotplug/Kconfig
```kconfig
config CORE_CONTROL
       bool "Shoaib's Core Control, a thermal based HotPlug."
       depends on FRANCO_THERMAL
       default y
       help
	    A Thermal Based Automatic HotPlug Driver capable of disabling 
            the whole big Cluster for better Heat management, 
	    built by Shoaib0597 a.k.a. Shoaib0597.

config AiO_HotPlug
       bool "An All in One HotPlug for all main types of SoCs."
       default y
       help
	    An All in One HotPlug for Quad, Hexa and Octa-Core SoCs as well as 
	    Traditional and big.LITTLE SoCs developed by Shoaib Anwar a.k.a Shoaib0597. 
	    This HotPlug is not a Load-Based HotPlug. Hence, this HotPlug is very 
	    Efficient in terms of CPU and Battery Consumption. Moreover, as the 
	    name indicates, this HotPlug provides absolute flexibility in terms 
	    of usage.
```
